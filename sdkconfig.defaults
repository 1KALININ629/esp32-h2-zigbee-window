## sdkconfig.defaults
```kconfig
# Общие настройки
CONFIG_ESP_MAIN_TASK_STACK_SIZE=4096
CONFIG_FREERTOS_HZ=1000

# Настройки целевого устройства: ESP32-C6
CONFIG_IDF_TARGET="esp32c6"
CONFIG_ESPTOOLPY_FLASHMODE_QIO=y
CONFIG_ESPTOOLPY_FLASHFREQ_80M=y
CONFIG_ESPTOOLPY_FLASHSIZE_4MB=y

# Настройки ZigBee
CONFIG_ZB_ENABLED=y
CONFIG_ZB_RADIO_NATIVE=y
CONFIG_ZB_ZCZR=y
CONFIG_ZB_MANUFACTURER_NAME="Espressif"
CONFIG_ZB_MODEL_NAME="ESP32-C6-ZigBee-Window"
CONFIG_ESP_CONSOLE_UART=y

# Настройки для управления питанием
CONFIG_PM_ENABLE=y
CONFIG_ESP_SLEEP_POWER_DOWN_FLASH=y
CONFIG_ESP_SLEEP_GPIO_RESET_WORKAROUND=y

# Настройки ADC
CONFIG_ADC_CAL_EFUSE_TP_ENABLE=y
CONFIG_ADC_CAL_EFUSE_VREF_ENABLE=y
CONFIG_ADC_CAL_LUT_ENABLE=y

# Настройки OTA
CONFIG_BOOTLOADER_APP_ROLLBACK_ENABLE=y
CONFIG_OTA_ALLOW_HTTP=y
CONFIG_ESP_HTTPS_OTA_ALLOW_HTTP=y

# Настройки системы
CONFIG_ESP_TASK_WDT_TIMEOUT_S=10
CONFIG_SPIRAM=n

# Настройки логирования
CONFIG_LOG_DEFAULT_LEVEL_INFO=y
CONFIG_LOG_COLORS=y

# Отключение Bluetooth для экономии памяти
CONFIG_BT_ENABLED=n 
```
